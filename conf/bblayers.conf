## conf/bblayers.conf
```bitbake
# POKY_BBLAYERS_CONF_VERSION is increased each time build/conf/bblayers.conf
# changes incompatibly
POKY_BBLAYERS_CONF_VERSION = "2"

BBPATH = "${TOPDIR}"
BBFILES ?= ""

BBLAYERS ?= " \
  /home/hieu/Yocto/poky/meta \
  /home/hieu/Yocto/poky/meta-poky \
  /home/hieu/Yocto/poky/meta-yocto-bsp \
  /home/hieu/Yocto/poky/meta-openembedded/meta-oe \
  /home/hieu/Yocto/poky/meta-openembedded/meta-python \
  /home/hieu/Yocto/poky/meta-openembedded/meta-networking \
  /home/hieu/Yocto/poky/meta-openembedded/meta-perl \
  /home/hieu/Yocto/poky/meta-security \
  /home/hieu/Yocto/poky/meta-selinux \
  /home/hieu/Yocto/poky/meta-raspberrypi \
  /home/hieu/Yocto/poky/meta-secure-rpi \
  "
```

## layers/meta-secure-rpi/conf/layer.conf
```bitbake
BBPATH .= ":${LAYERDIR}"

BBFILES += "${LAYERDIR}/recipes-*/*/*.bb \
            ${LAYERDIR}/recipes-*/*/*.bbappend"

BBFILE_COLLECTIONS += "secure-rpi"
BBFILE_PATTERN_secure-rpi := "^${LAYERDIR}/"
BBFILE_PRIORITY_secure-rpi = "6"

LAYERDEPENDS_secure-rpi = "core raspberrypi openembedded-layer security selinux"

LAYERSERIES_COMPAT_secure-rpi = "kirkstone"

WKS_SEARCH_PATH:append = " ${LAYERDIR}/wic"
```
