## DATN-main/yocto/build/conf/bblayers.conf
```bitbake
# POKY_BBLAYERS_CONF_VERSION is increased each time build/conf/bblayers.conf
# changes incompatibly
POKY_BBLAYERS_CONF_VERSION = "2"

BBPATH = "${TOPDIR}"
BBFILES ?= ""

BBLAYERS ?= " \
  /workspace/DATN-main/yocto/meta \
  /workspace/DATN-main/yocto/meta-poky \
  /workspace/DATN-main/yocto/meta-yocto-bsp \
  /workspace/layers/meta-rs485 \
  /workspace/layers/meta-raspberrypi \
  /workspace/layers/meta-openembedded/meta-oe \
  /workspace/layers/meta-openembedded/meta-python \
  /workspace/layers/meta-openembedded/meta-networking \
  /workspace/layers/meta-openembedded/meta-multimedia \
  /workspace/DATN-main/yocto/meta-networkconnection \
  "
```

## DATN-main/yocto/meta-networkconnection/conf/layer.conf
```bitbake
# We have a conf and classes directory, add to BBPATH
BBPATH .= ":${LAYERDIR}"

# We have recipes-* directories, add to BBFILES
BBFILES += "${LAYERDIR}/recipes-*/*/*.bb \
            ${LAYERDIR}/recipes-*/*/*.bbappend"

BBFILE_COLLECTIONS += "meta-networkconnection"
BBFILE_PATTERN_meta-networkconnection = "^${LAYERDIR}/"
BBFILE_PRIORITY_meta-networkconnection = "6"

LAYERDEPENDS_meta-networkconnection = "core"
LAYERSERIES_COMPAT_meta-networkconnection = "kirkstone"
```

## layers/meta-rs485/conf/layer.conf
```bitbake
# We have a conf and classes directory, add to BBPATH
BBPATH .= ":${LAYERDIR}"

# We have recipes-* directories, add to BBFILES
BBFILES += "${LAYERDIR}/recipes-*/*/*.bb \
            ${LAYERDIR}/recipes-*/*/*.bbappend"

BBFILE_COLLECTIONS += "meta-rs485"
BBFILE_PATTERN_meta-rs485 = "^${LAYERDIR}/"
BBFILE_PRIORITY_meta-rs485 = "6"

LAYERSERIES_COMPAT_meta-rs485 = "kirkstone"
```

## meta-rs485-driver/conf/layer.conf
```bitbake
# We have a conf and classes directory, add to BBPATH
BBPATH .= ":${LAYERDIR}"

# We have recipes-* directories, add to BBFILES
BBFILES += "${LAYERDIR}/recipes-*/*/*.bb \
            ${LAYERDIR}/recipes-*/*/*.bbappend"

BBFILE_COLLECTIONS += "meta-rs485-driver"
BBFILE_PATTERN_meta-rs485-driver = "^${LAYERDIR}/"
BBFILE_PRIORITY_meta-rs485-driver = "6"

LAYERDEPENDS_meta-rs485-driver = "core"
LAYERSERIES_COMPAT_meta-rs485-driver = "kirkstone"
```
